## config/boards/shields/pinsel/Kconfig.defconfig
```kconfig
# Copyright (c) 2020 The ZMK Contributors
# SPDX-License-Identifier: MIT

if SHIELD_PINSEL_LEFT

config ZMK_KEYBOARD_NAME
	default "Pinsel"

config ZMK_SPLIT_BLE_ROLE_CENTRAL
	default y

endif

if SHIELD_PINSEL_LEFT || SHIELD_PINSEL_RIGHT

config ZMK_SPLIT
	default y

endif
```
